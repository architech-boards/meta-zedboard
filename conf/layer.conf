## conf/layer.conf
```bitbake
# Let bitbake find our .bbclass and .conf files
BBPATH .= ":${LAYERDIR}"

# Let bitbake know where to look for .bb and .bbappend files
BBFILES += "${LAYERDIR}/recipes-*/*/*.bb \
            ${LAYERDIR}/recipes-*/*/*.bbappend"

BBFILE_COLLECTIONS += "zedboard"
BBFILE_PATTERN_microzed := "^${LAYERDIR}/"
BBFILE_PRIORITY_microzed = "6"
```

## recipes-kernel/conf/machine/zedboard.conf
```bitbake
#@TYPE: Machine
#@NAME: zedboard
#@DESCRIPTION: Machine support for ZedBoard board. (http://www.zedboard.org/product/zedboard)

# File System Configuration
IMAGE_FSTYPES ?= "cpio tar.gz ext2 ext2.gz.u-boot ext2.gz"
IMAGE_CLASSES += "image_types_uboot"

# Kernel Configuration
PREFERRED_PROVIDER_virtual/kernel = "linux-xlnx"
PREFERRED_VERSION_linux-xlnx = "3.17%"
PREFERRED_VERSION_linux-yocto ?= "3.14%"
PREFERRED_VERSION_linux-yocto-tiny ?= "3.14%"

# U-Boot Configuration
PREFERRED_PROVIDER_virtual/bootloader = "u-boot-xlnx"
PREFERRED_PROVIDER_u-boot = "u-boot-xlnx"
PREFERRED_VERSION_u-boot-xlnx = "v2014.01%"
UBOOT_SUFFIX ?= "img"

require conf/machine/include/tune-zynq.inc
require conf/machine/include/machine-xilinx-board.inc

UBOOT_MACHINE = "zynq_zed_config"

SERIAL_CONSOLE = "115200 ttyPS0"
```
